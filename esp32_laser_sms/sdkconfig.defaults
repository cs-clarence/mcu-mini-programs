## esp32_laser_sms/sdkconfig.defaults
```kconfig
# Rust often needs a bit of an extra main task stack size compared to C (the default is 3K)
CONFIG_ESP_MAIN_TASK_STACK_SIZE=65536

# Use this to set FreeRTOS kernel tick frequency to 1000 Hz (100 Hz by default).
# This allows to use 1 ms granuality for thread sleeps (10 ms by default).
#CONFIG_FREERTOS_HZ=1000

# Workaround for https://github.com/espressif/esp-idf/issues/7631
#CONFIG_MBEDTLS_CERTIFICATE_BUNDLE=n
#CONFIG_MBEDTLS_CERTIFICATE_BUNDLE_DEFAULT_FULL=n

# PSRAM
# CONFIG_SPIRAM=y
# When SPIRAM is not present, we can still boot and run from flash
#CONFIG_SPIRAM_IGNORE_NOTFOUND=y
#CONFIG_SPIRAM_USE_MALLOC=y
#CONFIG_SPIRAM_SPEED_80M=y
#CONFIG_SPIRAM_MODE_OCT=y
#CONFIG_SPIRAM_MODE_QUAD=y
#CONFIG_SPIRAM_BOOT_INIT=y
#CONFIG_SPIRAM_FETCH_INSTRUCTIONS=y
#CONFIG_SPIRAM_ALLOW_BSS_SEG_EXTERNAL_MEMORY=y
#CONFIG_SPIRAM_TRY_ALLOCATE_WIFI_LWIP=y
#CONFIG_SPIRAM_RODATA=y

# TLS
CONFIG_ESP_TLS_INSECURE=y
CONFIG_ESP_TLS_SKIP_SERVER_CERT_VERIFY=y

# BLE
#CONFIG_BT_ENABLED=y
#CONFIG_BT_BLE_ENABLED=y
#CONFIG_BT_BLUEDROID_ENABLED=n
#CONFIG_BT_NIMBLE_ENABLED=y
# Not really widely supported yet, so disable for now. Use legacy advertising instead.
#CONFIG_BT_NIMBLE_EXT_ADV=y
#

# FatFS
CONFIG_FATFS_LONG_FILENAMES=y

# Log
CONFIG_LOG_MAXIMUM_LEVEL_ERROR=y

# Threads
CONFIG_PTHREAD_TASK_STACK_SIZE_DEFAULT=65536
```
